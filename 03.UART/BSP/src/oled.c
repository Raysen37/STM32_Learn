//////////////////////////////////////////////////////////////////////////////////	 
//本程序只供学习使用，未经作者许可，不得用于其它任何用途
//测试硬件：单片机STM32F103RCT6,正点原子MiniSTM32开发板,主频72MHZ，晶振12MHZ
//QDtech-OLED液晶驱动 for STM32
//xiao冯@ShenZhen QDtech co.,LTD
//公司网站:www.qdtft.com
//淘宝网站：http://qdtech.taobao.com
//wiki技术网站：http://www.lcdwiki.com
//我司提供技术支持，任何技术问题欢迎随时交流学习
//固话(传真) :+86 0755-23594567 
//手机:15989313508（冯工） 
//邮箱:lcdwiki01@gmail.com    support@lcdwiki.com    goodtft@163.com
//技术支持QQ:3002773612  3002778157
//技术交流QQ群:324828016
//创建日期:2018/8/27
//版本：V1.0
//版权所有，盗版必究。
//Copyright(C) 深圳市全动电子技术有限公司 2018-2028
//All rights reserved
/****************************************************************************************************
//=========================================电源接线================================================//
// OLED模块               STM32单片机
//   VCC         接       DC 5V/3.3V      //OLED屏电源正
//   GND         接          GND          //OLED屏电源地
//=======================================液晶屏数据线接线==========================================//
//本模块默认数据总线类型为4线制SPI
// OLED模块               STM32单片机
//   D1          接          PB15        //OLED屏SPI写信号
//=======================================液晶屏控制线接线==========================================//
// OLED模块               STM32单片机
//   CS          接          PB11        //OLED屏片选控制信号
//   RES         接          PB12        //OLED屏复位控制信号
//   DC          接          PB10        //OLED屏数据/命令选择控制信号
//   D0          接          PB13        //OLED屏SPI时钟信号
//=========================================触摸屏接线=========================================//
//本模块不带触摸功能，所以不需要触摸屏接线
****************************************************************************************************/	
/***************************************************************************************************
  * @attention
  *
  * THE PRESENT FIRMWARE WHICH IS FOR GUIDANCE ONLY AIMS AT PROVIDING CUSTOMERS
  * WITH CODING INFORMATION REGARDING THEIR PRODUCTS IN ORDER FOR THEM TO SAVE
  * TIME. AS A RESULT, QD electronic SHALL NOT BE HELD LIABLE FOR ANY
  * DIRECT, INDIRECT OR CONSEQUENTIAL DAMAGES WITH RESPECT TO ANY CLAIMS ARISING
  * FROM THE CONTENT OF SUCH FIRMWARE AND/OR THE USE MADE BY CUSTOMERS OF THE
  * CODING INFORMATION CONTAINED HEREIN IN CONNECTION WITH THEIR PRODUCTS.
****************************************************************************************************/	
#include "oled.h"
#include "stdlib.h"
#include "string.h" 
#include "bsp_IIC.h"
//#include "delay.h"
//#include "spi.h"

//OLED显存总共分为8页
//每页8行，一行128个像素点
//OLED的显存
//存放格式如下.
//[0]0 1 2 3 ... 127 (0~7)行	   
//[1]0 1 2 3 ... 127 (8~15)行	
//[2]0 1 2 3 ... 127 (16~23)行	
//[3]0 1 2 3 ... 127 (24~31)行	
//[4]0 1 2 3 ... 127 (32~39)行	
//[5]0 1 2 3 ... 127 (40~47)行	
//[6]0 1 2 3 ... 127 (48~55)行	
//[7]0 1 2 3 ... 127 (56~63)行			   

//数组每个bit存储OLED每个像素点的颜色值(1-亮(白色),0-灭(黑色))
//每个数组元素表示1列8个像素点，一共128列
static unsigned char OLED_buffer[1024] = 
{
	0x00,0x00,0x00,0x00,0x00,0x00,0x00,0x00,0x00,0x00,0x00,0x00,0x00,0x00,0x00,0x00,
	0x00,0x00,0x00,0x00,0x00,0x00,0x00,0x00,0x00,0x00,0x00,0x00,0x00,0x00,0x00,0x00,
	0x00,0x00,0x00,0x00,0x00,0x00,0x00,0x00,0x00,0x00,0x00,0x00,0x00,0x00,0x00,0x00,
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	0x00,0x00,0x00,0x00,0x00,0x00,0x00,0x00,0x00,0x00,0x00,0x00,0x00,0x00,0x00,0x00,
};


/**********************************************
// IIC 写入命令
**********************************************/
void Write_IIC_Command(unsigned char IIC_Command)
{
	I2C_Start();  // 启动 I2C 总线
	I2C_WriteByte(IIC_SLAVE_ADDR); // 发送从设备地址，SA0=0
	I2C_GetAck();  // 等待应答
	I2C_WriteByte(0x00); // 写入命令标识
	I2C_GetAck();  // 等待应答
	I2C_WriteByte(IIC_Command); // 写入具体命令
	I2C_GetAck();  // 等待应答
	I2C_Stop(); // 停止 I2C 总线
}

/**********************************************
// IIC 写入数据
**********************************************/
void Write_IIC_Data(unsigned char IIC_Data)
{
	I2C_Start(); // 启动 I2C 总线
	I2C_WriteByte(IIC_SLAVE_ADDR); // D/C#=0; R/W#=0
	I2C_GetAck(); // 等待应答
	I2C_WriteByte(0x40); // 写入数据标识
	I2C_GetAck(); // 等待应答
	I2C_WriteByte(IIC_Data); // 写入具体数据
	I2C_GetAck(); // 等待应答
	I2C_Stop(); // 停止 I2C 总线
}

/*******************************************************************
 * @name       :void OLED_WR_Byte(unsigned dat,unsigned cmd)
 * @date       :2018-08-27
 * @function   :向 OLED 显示屏写入一个字节的内容
 * @parameters :dat: 要写入的内容
 *               cmd: 0-写入命令
 *                    1-写入数据
 * @retvalue   : None
********************************************************************/
void OLED_WR_Byte(unsigned dat, unsigned cmd)
{
	if (cmd) // 如果是数据
	{
		Write_IIC_Data(dat); // 写入数据
	}
	else // 如果是命令
	{
		Write_IIC_Command(dat); // 写入命令
	}
}

/*******************************************************************
 * @name       :void OLED_Set_Pos(unsigned char x, unsigned char y)
 * @date       :2018-08-27
 * @function   :设置 OLED 屏幕的坐标
 * @parameters :x: x 坐标
 *               y: y 坐标
 * @retvalue   : None
********************************************************************/
void OLED_Set_Pos(unsigned char x, unsigned char y)
{
	OLED_WR_Byte(YLevel + y / PAGE_SIZE, OLED_CMD); // 设置页地址
	OLED_WR_Byte((((x + 2) & 0xf0) >> 4) | 0x10, OLED_CMD); // 设置高四位列地址
	OLED_WR_Byte(((x + 2) & 0x0f), OLED_CMD); // 设置低四位列地址
}

/*******************************************************************
 * @name       :void OLED_Display_On(void)
 * @date       :2018-08-27
 * @function   :打开 OLED 显示
 * @parameters :None
 * @retvalue   :None
 ********************************************************************/
void OLED_Display_On(void)
{
	OLED_WR_Byte(0X8D, OLED_CMD); // 设置 DCDC
	OLED_WR_Byte(0X14, OLED_CMD); // DCDC 开启
	OLED_WR_Byte(0XAF, OLED_CMD); // 显示开启
}

/*******************************************************************
 * @name       :void OLED_Display_Off(void)
 * @date       :2018-08-27
 * @function   :关闭 OLED 显示
 * @parameters :None
 * @retvalue   :None
 ********************************************************************/
void OLED_Display_Off(void)
{
	OLED_WR_Byte(0X8D, OLED_CMD); // 设置 DCDC
	OLED_WR_Byte(0X10, OLED_CMD); // DCDC 关闭
	OLED_WR_Byte(0XAE, OLED_CMD); // 显示关闭
}

/*******************************************************************
 * @name       :void OLED_Set_Pixel(unsigned char x, unsigned char y, unsigned char color)
 * @date       :2018-08-27
 * @function   :设置像素值到 RAM
 * @parameters :x: 像素的 x 坐标
 *               y: 像素的 y 坐标
 *               color: 像素的颜色值
 *                       1-白色
 *                       0-黑色
 * @retvalue   :None
********************************************************************/
void OLED_Set_Pixel(unsigned char x, unsigned char y, unsigned char color)
{
	if (color) // 如果颜色为白色
	{
		OLED_buffer[(y / PAGE_SIZE) * WIDTH + x] |= (1 << (y % PAGE_SIZE)) & 0xff; // 设置像素
	}
	else // 如果颜色为黑色
	{
		OLED_buffer[(y / PAGE_SIZE) * WIDTH + x] &= ~((1 << (y % PAGE_SIZE)) & 0xff); // 清除像素
	}
}

/*******************************************************************
 * @name       :void OLED_Display(void)
 * @date       :2018-08-27
 * @function   :在 OLED 显示屏上显示内容
 * @parameters :None
 * @retvalue   :None
 ********************************************************************/
void OLED_Display(void)
{
	uint8_t i, n;
	for (i = 0; i < PAGE_SIZE; i++) // 遍历每一页
	{
		OLED_WR_Byte(YLevel + i, OLED_CMD); // 设置页地址
		OLED_WR_Byte(XLevelL, OLED_CMD); // 设置列地址低位
		OLED_WR_Byte(XLevelH, OLED_CMD); // 设置列地址高位
		for (n = 0; n < WIDTH; n++) // 遍历每一列
		{
			OLED_WR_Byte(OLED_buffer[i * WIDTH + n], OLED_DATA); // 写入数据到显示屏
		}
	} // 完成页面显示
}

/*******************************************************************
 * @name       :void OLED_Clear(unsigned dat)
 * @date       :2018-08-27
 * @function   :清除 OLED 屏幕
 * @parameters :dat: 0-全黑显示
 *               1-全白显示
 * @retvalue   :None
********************************************************************/
void OLED_Clear(unsigned dat)
{
	if (dat) // 如果需要全白
	{
		memset(OLED_buffer, 0xff, sizeof(OLED_buffer)); // 填充全白
	}
	else // 如果需要全黑
	{
		memset(OLED_buffer, 0, sizeof(OLED_buffer)); // 填充全黑
	}
	OLED_Display(); // 更新显示
}

/*******************************************************************
 * @name       :void OLED_Init(void)
 * @date       :2018-08-27
 * @function   :初始化 OLED SH1106 控制器
 * @parameters :None
 * @retvalue   :None
 ********************************************************************/
void OLED_Init(void)
{
	I2C_GPIO_ReInit(); // 重新初始化 GPIO
	HAL_Delay(200); // 延时 200 毫秒

	/************** 初始化 SSD1306 *****************/
	OLED_WR_Byte(0xAE, OLED_CMD); // 关闭显示
	OLED_WR_Byte(0x00, OLED_CMD); // 设置低列地址
	OLED_WR_Byte(0x10, OLED_CMD); // 设置高列地址
	OLED_WR_Byte(0x40, OLED_CMD); // 设置起始行
	OLED_WR_Byte(0xB0, OLED_CMD); // 设置页地址
	OLED_WR_Byte(0x81, OLED_CMD); // 对比度控制
	OLED_WR_Byte(0xFF, OLED_CMD); // 设置对比度为最大
	OLED_WR_Byte(0xA1, OLED_CMD); // 设置段重映射
	OLED_WR_Byte(0xA6, OLED_CMD); // 正常/反向显示
	OLED_WR_Byte(0xA8, OLED_CMD); // 复用率设置
	OLED_WR_Byte(0x3F, OLED_CMD); // 1/64 复用
	OLED_WR_Byte(0xC8, OLED_CMD); // COM 扫描方向
	OLED_WR_Byte(0xD3, OLED_CMD); // 设置显示偏移
	OLED_WR_Byte(0x00, OLED_CMD); // 偏移量
	OLED_WR_Byte(0xD5, OLED_CMD); // 设置振荡器分频
	OLED_WR_Byte(0x80, OLED_CMD); // 设置分频
	OLED_WR_Byte(0xD9, OLED_CMD); // 设置预充电周期
	OLED_WR_Byte(0XF1, OLED_CMD); // 设置预充电周期
	OLED_WR_Byte(0xDA, OLED_CMD); // 设置 COM 引脚
	OLED_WR_Byte(0x12, OLED_CMD); // 设置 COM 引脚配置
	OLED_WR_Byte(0xDB, OLED_CMD); // 设置 VCOMH
	OLED_WR_Byte(0x30, OLED_CMD); // 设置 VCOMH 电压
	OLED_WR_Byte(0x8D, OLED_CMD); // 设置充电泵禁用
	OLED_WR_Byte(0x14, OLED_CMD); // 开启充电泵
	OLED_WR_Byte(0xAF, OLED_CMD); // 开启显示
}

void OLED_change(void)
{
	OLED_WR_Byte(0x2e, OLED_CMD); // 停止滚动
	OLED_WR_Byte(0x2A, OLED_CMD); // 设置垂直滚动区域
	OLED_WR_Byte(0x00, OLED_CMD); // 起始地址
	OLED_WR_Byte(0x00, OLED_CMD); // 结束地址
	OLED_WR_Byte(0x01, OLED_CMD); // 垂直滚动的行数
	OLED_WR_Byte(0x00, OLED_CMD); // 设置地址
	OLED_WR_Byte(0x2f, OLED_CMD); // 启动滚动
}
